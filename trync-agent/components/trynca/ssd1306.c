#include <esp_log.h>
#include <freertos/FreeRTOS.h>
#include <stdio.h>
#include <driver/i2c.h>

#include <trynca-i2c.h>
#include <ssd1306.h>





SemaphoreHandle_t print_mux = NULL;

uint8_t line = 0x00;

uint8_t buffer[] = { 0x00, 0x00, 0x00, 0x80, 0xC0, 0xE0, 0xF0, 0xF9, 0xFF, 0xFF,
		0xFF, 0xFF, 0xFF, 0x3F, 0x1F, 0x0F, 0x87, 0xC7, 0xF7, 0xFF, 0xFF, 0x1F,
		0x1F, 0x3D, 0xFC, 0xF8, 0xF8, 0xF8, 0xF8, 0x7C, 0x7D, 0xFF, 0xFF, 0xFF,
		0xFF, 0xFF, 0xFF, 0xFF, 0xFF, 0x7F, 0x3F, 0x0F, 0x07, 0x00, 0x30, 0x30,
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		0x00, 0x00, 0x00, 0x00, 0x00, 0x00, 0x00, 0x00, 0x00, 0x00 };

const uint8_t F8X16[] = { 0x00, 0x00, 0x00, 0x00, 0x00, 0x00, 0x00, 0x00, 0x00,
		0x00, 0x00, 0x00, 0x00, 0x00, 0x00,
		0x00, // 0
		0x00, 0x00, 0x00, 0xF8, 0x00, 0x00, 0x00, 0x00, 0x00, 0x00, 0x00, 0x33,
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		0x00, 0x00, 0x00, 0x00, //~94

		};




void ssd1306_command(uint8_t command) {

	esp_err_t ret = i2c_write_byte(SSD1306_ADDRESS, command);
	if (ret != ESP_OK) {
		ESP_LOGE("OLED", "OLED Command %X error (ERR = %d)", command, ret);
	}
	vTaskDelay(5 / portTICK_PERIOD_MS);
}

void OLEDSetPos(uint8_t x, uint8_t y) {
	ssd1306_command(0xb0 + y);
	ssd1306_command(((x & 0xf0) >> 4) | 0x10);
	ssd1306_command((x & 0x0f) | 0x00);
}

void OLED_P8x16Str(uint8_t x, uint8_t y, char ch[]) {

	unsigned char c = 0, i = 0, j = 0;
	while (ch[j] != '\0') {
		c = ch[j] - 32;
		if (x > 120) {
			x = 0;
			y++;
		}
		OLEDSetPos(x, y);
		i2c_write_byte(SSD1306_ADDRESS, 0x40);
		for (i = 0; i < 8; i++) {
			//writeData(F8X16[(c << 4) + i]);
			/**i2c_cmd_handle_t cmd = i2c_cmd_link_create();
			 i2c_master_start(cmd);
			 i2c_master_write_byte(cmd, 0x3C << 1 | WRITE_BIT,
			 ACK_CHECK_EN);
			 i2c_master_write_byte(cmd, 0x40, ACK_CHECK_EN);**/
			i2c_write_byte(SSD1306_ADDRESS, F8X16[(c << 4) + i]);
			/**i2c_master_stop(cmd);
			 i2c_master_cmd_begin(I2C_EXAMPLE_MASTER_NUM, cmd,
			 1000 / portTICK_PERIOD_MS);
			 i2c_cmd_link_delete(cmd);**/
			// _delay_ms(10);
		}

		OLEDSetPos(x, y + 1);
		i2c_write_byte(SSD1306_ADDRESS, 0x40);
		for (i = 0; i < 8; i++) {
			//writeData(F8X16[(c << 4) + i + 8]);
			/**i2c_cmd_handle_t cmd = i2c_cmd_link_create();
			 i2c_master_start(cmd);
			 i2c_master_write_byte(cmd, 0x3C << 1 | WRITE_BIT,
			 ACK_CHECK_EN);
			 i2c_master_write_byte(cmd, 0x40, ACK_CHECK_EN);**/
			i2c_write_byte(SSD1306_ADDRESS, F8X16[(c << 4) + i + 8]);
			/**i2c_master_stop(cmd);
			 i2c_master_cmd_begin(I2C_EXAMPLE_MASTER_NUM, cmd,
			 1000 / portTICK_PERIOD_MS);
			 i2c_cmd_link_delete(cmd);**/
			//_delay_ms(10);
		}
		x += 8;
		j++;
	}

}

void OLEDFill(uint8_t bmp_data) {
	unsigned char y, x;

	for (y = 0; y < 8; y++) {
		ssd1306_command(0xb0 + y);
		ssd1306_command(0x00);
		ssd1306_command(0x10);
		i2c_write_byte(SSD1306_ADDRESS, 0x40);
		for (x = 0; x < 128; x++) {
			i2c_write_byte(SSD1306_ADDRESS, bmp_data);
			//writeData(bmp_data);
		}
	}
}

void OLEDInit() {
	ssd1306_command(SSD1306_DISPLAYOFF);                    // 0xAE
	ssd1306_command(SSD1306_SETDISPLAYCLOCKDIV);            // 0xD5
	ssd1306_command(0x80);                      // the suggested ratio 0x80

	ssd1306_command(SSD1306_SETMULTIPLEX);                  // 0xA8
	ssd1306_command(SSD1306_LCDHEIGHT - 1);

	ssd1306_command(SSD1306_SETDISPLAYOFFSET);              // 0xD3
	ssd1306_command(0x0);                                   // no offset
	ssd1306_command(SSD1306_SETSTARTLINE | 0x0);            // line #0
	ssd1306_command(SSD1306_CHARGEPUMP);                    // 0x8D
	ssd1306_command(0x14);
	ssd1306_command(SSD1306_MEMORYMODE);                    // 0x20
	ssd1306_command(0x00);                           // 0x0 act like ks0108
	ssd1306_command(SSD1306_SEGREMAP | 0x1);
	ssd1306_command(SSD1306_COMSCANDEC);

	ssd1306_command(SSD1306_SETCOMPINS);                    // 0xDA
	ssd1306_command(0x12);
	ssd1306_command(SSD1306_SETCONTRAST);                   // 0x81
	ssd1306_command(0xCF);

	ssd1306_command(SSD1306_SETPRECHARGE);                  // 0xd9
	ssd1306_command(0xF1);
	ssd1306_command(SSD1306_SETVCOMDETECT);                 // 0xDB
	ssd1306_command(0x40);
	ssd1306_command(SSD1306_DISPLAYALLON_RESUME);           // 0xA4
	//ssd1306_command(SSD1306_NORMALDISPLAY);                 // 0xA6
	ssd1306_command(SSD1306_INVERTDISPLAY);
	ssd1306_command(SSD1306_DEACTIVATE_SCROLL);

	ssd1306_command(SSD1306_DISPLAYON);
	ssd1306_command(SSD1306_DISPLAYON);

	OLEDFill(0x00);
}
